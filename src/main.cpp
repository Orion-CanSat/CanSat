//-------------------------------------------------------------------------------------------------------------------------------------------------
// Generated by Make me a Makefile (https://github.com/Orion-CanSat/Make-me-a-Makefile)
//
// Board:            Teensy 4.1/Teensy 3.6
// CPU Speed:        600000000/256000000
// Optimization:     -O3
// 
// Time of creation: 2020/12/05 12:57
//-------------------------------------------------------------------------------------------------------------------------------------------------

#include <stdint.h>

#ifdef ARDUINO
    #include <Arduino.h>
    #include <SD.h>
#endif

#include <Orion/Orion.hpp>
#include <Orion/Data/Data.hpp>
#include <Orion/Data/Alitutde.hpp>
#include <Orion/Data/AngularVelocity.hpp>
#include <Orion/Data/GravitationalAcceleration.hpp>
#include <Orion/Data/Humidity.hpp>
#include <Orion/Data/Latitude.hpp>
#include <Orion/Data/LinearAcceleration.hpp>
#include <Orion/Data/LinearDisplacement.hpp>
#include <Orion/Data/LinearVelocity.hpp>
#include <Orion/Data/Longitude.hpp>
#include <Orion/Data/Magnetism.hpp>
#include <Orion/Data/Pressure.hpp>
#include <Orion/Data/RotationalAngle.hpp>
#include <Orion/Data/Temperature.hpp>
#include <Orion/Sensors/Sensor.hpp>
#include <Orion/Sensors/BME280.hpp>
#include <Orion/Sensors/BNO055.hpp>
#include <Orion/Sensors/TeensyChipTemperature.hpp>
#include <Orion/Sensors/GPS/Coordinates.hpp>
#include <Orion/Sensors/GPS/GPS.hpp>
#include <Orion/Sensors/GPS/MTK3339.hpp>
#include <Orion/Utilities/IO/TTY.hpp>
#include <Orion/Utilities/Time/Delay.hpp>

#include "Debug.hpp"
#include "main.hpp"
#include "RF.hpp"

#define BNO_RST 40

extern float tempmonGetTemp(void);

static Orion::Sensors::Sensor* BME280 = NULL;
static Orion::Sensors::Sensor* BNO055 = NULL;
static Orion::Sensors::Sensor* MTK3339 = NULL;
static Orion::Sensors::Sensor* TeensyChipTemperature = NULL;

static Orion::Data::Data* Altitude = NULL;
static Orion::Data::Data* Latitude = NULL;
static Orion::Data::Data* Longitude = NULL;
static Orion::Data::Data* EnvHumidity = NULL;
static Orion::Data::Data* EnvPressure = NULL;
static Orion::Data::Data* EnvTemperature = NULL;
static Orion::Data::Data* ChipTemperature = NULL;


void InitializeBetelgeuse() {
#if defined(__IMXRT1062__)
    pinMode(28, OUTPUT);
    digitalWrite(28, HIGH);
#endif
    BME280 = new Orion::Sensors::BME280(__I2C__);
    if (BME280 && BME280->IsInitialized()) {
        Info("BME280: State: Init");
    }
    else {
        Error("BME280: State: Not Init");
    }

    orionout.Flush();
    Orion::Utilities::Time::Delay::DelayS(1);

#if defined(__IMXRT1062__)
    pinMode(BNO_RST, OUTPUT);
    digitalWrite(BNO_RST, HIGH);
    Orion::Utilities::Time::Delay::DelayMS(100);
    digitalWrite(BNO_RST, LOW);
    Orion::Utilities::Time::Delay::DelayMS(100);

    pinMode(22, OUTPUT);
    digitalWrite(22, HIGH);
#endif
    BNO055 = new Orion::Sensors::BNO055(__I2C__);
    if (BNO055 && BNO055->IsInitialized()) {
        Info("BNO055: State: Init");
    }
    else {
        Error("BNO055: State: Not Init");
    }

    orionout.Flush();
    Orion::Utilities::Time::Delay::DelayS(1);

    MTK3339 = new Orion::Sensors::GPS::MTK3339(&Serial3);
    if (MTK3339 && MTK3339->IsInitialized()) {
        Info("MTK3339: State: Init");
    }
    else {
        Error("MTK3339: State: Not Init");
    }

    orionout.Flush();
    Orion::Utilities::Time::Delay::DelayS(1);

    TeensyChipTemperature = new Orion::Sensors::TeensyChipTemperature((uint8_t)10);
    if (TeensyChipTemperature && TeensyChipTemperature->IsInitialized()) {
        Info("TeensyChipTemperature: State: Init");
    }
    else {
        Error("TeensyChipTemperature: State: Not Init");
    }

    orionout.Flush();
    Orion::Utilities::Time::Delay::DelayS(1);

    if (RFInit()) {
        Info("RF: State: Init");
    }
    else {
        Error("RF: State: Not Init");
    }

    orionout.Flush();
    Orion::Utilities::Time::Delay::DelayS(1);

    Altitude = new Orion::Data::Altitude(BME280);
    if (Altitude && Altitude->IsInitialized()) {
        Info("Altitude: State: Init");
    }
    else {
        Error("Altitude: State: Not Init");
    }

    orionout.Flush();
    Orion::Utilities::Time::Delay::DelayS(1);

    Latitude = new Orion::Data::Latitude(MTK3339);
    if (Latitude && Latitude->IsInitialized()) {
        Info("Latitude: State: Init");
    }
    else {
        Error("Latitude: State: Not Init");
    }

    orionout.Flush();
    Orion::Utilities::Time::Delay::DelayS(1);

    Longitude = new Orion::Data::Latitude(MTK3339);
    if (Longitude && Longitude->IsInitialized()) {
        Info("Longitude: State: Init");
    }
    else {
        Error("Longitude: State: Not Init");
    }

    orionout.Flush();
    Orion::Utilities::Time::Delay::DelayS(1);

    EnvHumidity = new Orion::Data::Humidity(BME280);
    if (EnvHumidity && EnvHumidity->IsInitialized()) {
        Info("EnvHumidity: State: Init");
    }
    else {
        Error("EnvHumidity: State: Not Init");
    }

    orionout.Flush();
    Orion::Utilities::Time::Delay::DelayS(1);

    EnvPressure = new Orion::Data::Pressure(BME280);
    if (EnvPressure && EnvPressure->IsInitialized()) {
        Info("EnvPressure: State: Init");
    }
    else {
        Error("EnvPressure: State: Not Init");
    }

    orionout.Flush();
    Orion::Utilities::Time::Delay::DelayS(1);

    EnvTemperature = new Orion::Data::Temperature(BME280);
    if (EnvTemperature && EnvTemperature->IsInitialized()) {
        Info("EnvTemperature: State: Init");
    }
    else {
        Error("EnvTemperature: State: Not Init");
    }

    orionout.Flush();
    Orion::Utilities::Time::Delay::DelayS(1);

    ChipTemperature = new Orion::Data::Temperature(TeensyChipTemperature);
    if (ChipTemperature && ChipTemperature->IsInitialized()) {
        Info("ChipTemperature: State: Init");
    }
    else {
        Error("ChipTemperature: State: Not Init");
    }
}

void UpdateBetelgeuse() {
    Debug("BME280: Update: Starting");
    if (BME280) {
        Debug("BME280: Update: On Wait");
        BME280->Update();
        Debug("BME280: Update: Success");
    }
    else {
        Error("BME280: Update: Failed");
    }
    Info("BME280: Update: Finished");

    orionout.Flush();

    Debug("BNO055: Update: Starting");
    if (BNO055) {
        Debug("BNO055: Update: On Wait");
        BNO055->Update();
        Debug("BNO055: Update: Success");
    }
    else {
        Error("BNO055: Update: Failed");
    }
    Info("BNO055: Update: Finished");

    orionout.Flush();

    Debug("MTK3339: Update: Starting");
    if (MTK3339) {
        Debug("MTK3339: Update: On Wait");
        MTK3339->Update();
        Debug("MTK3339: Update: Success");
    }
    else {
        Error("MTK3339: Update: Failed");
    }
    Info("MTK3339: Update: Finished");

    orionout.Flush();

    Debug("TeensyChipTemperature: Update: Starting");
    if (TeensyChipTemperature) {
        Debug("TeensyChipTemperature: Update: On Wait");
        TeensyChipTemperature->Update();
        Debug("TeensyChipTemperature: Update: Success");
    }
    else {
        Error("TeensyChipTemperature: Update: Failed");
    }
    Info("TeensyChipTemperature: Update: Finished");
}


int main(void)
{
    Orion::Utilities::Time::Delay::DelayS(1);
    Serial.begin(9600);

    Orion::Utilities::Time::Delay::DelayS(4);

    #if defined(__IMXRT1062__)
        Info("IMXRT1062: State: Init");
    #elif defined(__MK66FX1M0__)
        Info("MK66FX1M0: State: Init");
    #endif

    Orion::Utilities::Time::Delay::DelayS(1);

    Info("Serial: State: Init");

    Orion::Utilities::Time::Delay::DelayS(1);
    
    File dataFile;
    
    if (SD.begin(BUILTIN_SDCARD))
    {
        Info("SD: State: Init");

        if (SD.exists("data"))
            SD.remove("data");

        dataFile = SD.open("data", FILE_WRITE);
        if (dataFile) 
            Info("Data File: State: Init");
        else
            Error("Data File: State: Not Init");
    }    
    else
        Error("SD: State: Not Init");

    Orion::Utilities::Time::Delay::DelayS(1);

    orionout.Flush();
    InitializeBetelgeuse();
    orionout.Flush();
    
    pinMode(LED_BUILTIN, OUTPUT);
    digitalWrite(LED_BUILTIN, HIGH);

    const int blockStartingLine = __LINE__;
    float altitude;
    float envhumidity;
    float envpressure;
    float envtemperature;
    float chiptemperature;
    float latitude;
    float longitude;
    const int blockEndngLine = __LINE__;

    const uint8_t blockSize = (blockEndngLine - blockStartingLine - 1) * sizeof(float);
    
    uint8_t* data = (uint8_t*)malloc(225 * sizeof(uint8_t));
    if (!data) {
        Error("Could not allocate enough dataspace for the RF Buffer");
        orionout.Flush();
        while (true)
            __asm__("nop");
    }
    memset(data, 0, 225 * sizeof(uint8_t));

    char* sdBuffer = (char*)malloc(1024 * sizeof(char));
    if (!sdBuffer) {
        Error("Could not allocate enough data space for the SD Buffer");
        orionout.Flush();
        while (true)
            __asm__("nop");
    }
    memset(sdBuffer, 0, 1024 * sizeof(char));
    
    uint8_t dataPos = 0;

    while (true)
    {
        Debug("Starting Update");
        UpdateBetelgeuse();
        Debug("Ending Update");
        orionout.Flush();

        altitude = Altitude->Get();
        envhumidity = EnvHumidity->Get();
        envpressure = EnvPressure->Get();
        envtemperature = EnvTemperature->Get();
        chiptemperature = ChipTemperature->Get();
        latitude = Latitude->Get();
        longitude = Longitude->Get();

        orionout << altitude << " " << envhumidity << " " << envpressure << " " << envtemperature << " " << chiptemperature << " " << latitude << " " << longitude << Orion::Utilities::IO::endl;

        if(dataPos + blockSize <= 225){
#ifdef __GNUC__
#pragma GCC diagnostic push
#pragma GCC diagnostic ignored "-Wstrict-aliasing"
#endif
            *((uint32_t*)((int)data + dataPos)) = *((uint32_t*)&altitude);
            *((uint32_t*)((int)data + dataPos + 1 * sizeof(float))) = *((uint32_t*)&envhumidity);
            *((uint32_t*)((int)data + dataPos + 2 * sizeof(float))) = *((uint32_t*)&envpressure);
            *((uint32_t*)((int)data + dataPos + 3 * sizeof(float))) = *((uint32_t*)&envtemperature);
            *((uint32_t*)((int)data + dataPos + 4 * sizeof(float))) = *((uint32_t*)&chiptemperature);
            *((uint32_t*)((int)data + dataPos + 5 * sizeof(float))) = *((uint32_t*)&latitude);
            *((uint32_t*)((int)data + dataPos + 6 * sizeof(float))) = *((uint32_t*)&longitude);
            dataPos += blockSize;

#ifdef __GNUC__
#pragma GCC diagnostic pop
#endif
        }
        if (dataPos + blockSize > 225) {
            Debug("RF: Send: Starting");
            orionout.Flush();
            if (RFQueue(data, dataPos) && RFSendPacket()) {
                Debug("RF: Send: Succeeded");
            }
            else {
                Error("RF: Send: Failed");
            }
            Info("RF: Send: Finished");

            dataPos = 0;
        }

        if (dataFile) {
            snprintf(sdBuffer, 1024 * sizeof(char), "%.2f %.2f %.2f %.2f %.2f %.2f %.2f", altitude, envhumidity, envpressure, envtemperature, chiptemperature, latitude, longitude);
            dataFile.println(sdBuffer);
            dataFile.flush();
        }
        
        yield();
    }
}